## CMakeLists.txt
```
# SPDX-License-Identifier: Apache-2.0

cmake_minimum_required(VERSION 3.20.0)

set(mcuboot_CONFIG_MCUBOOT_ACTION_HOOKS_FILE_PATH \"${CMAKE_CURRENT_SOURCE_DIR}/src/mcuboot_action_hooks.c\")

find_package(Zephyr REQUIRED HINTS $ENV{ZEPHYR_BASE})
project(hello_world)

target_sources(app PRIVATE src/main.c)
```

## prj.conf
```kconfig
CONFIG_BOOTLOADER_MCUBOOT=y
CONFIG_MCUMGR=y
CONFIG_MCUMGR_SMP_UART=y
CONFIG_MCUMGR_CMD_IMG_MGMT=y
```

## src/main.c
```c
/*
 * Copyright (c) 2012-2014 Wind River Systems, Inc.
 *
 * SPDX-License-Identifier: Apache-2.0
 */

#include <zephyr/kernel.h>


void main(void)
{
	printk("Change this to see it change.\n");
}
```

## src/mcuboot_action_hooks.c
```c
#include <zephyr/logging/log.h>
#include "bootutil/mcuboot_status.h"

LOG_MODULE_REGISTER(custom_mcuboot_action_hooks,4);


void mcuboot_status_change(mcuboot_status_type_t status){
  switch(status) 
  {
    case MCUBOOT_STATUS_STARTUP:
      LOG_INF("MCUBOOT_STATUS_STARTUP\n");
      break;

    case MCUBOOT_STATUS_UPGRADING:
      LOG_INF("MCUBOOT_STATUS_UPGRADING\n");
      break;

    case MCUBOOT_STATUS_BOOTABLE_IMAGE_FOUND:
      LOG_INF("MCUBOOT_STATUS_BOOTABLE_IMAGE_FOUND\n");
      break;

    case MCUBOOT_STATUS_NO_BOOTABLE_IMAGE_FOUND:
      LOG_INF("MCUBOOT_STATUS_NO_BOOTABLE_IMAGE_FOUND\n");
      break;

    case MCUBOOT_STATUS_BOOT_FAILED:
      LOG_INF("MCUBOOT_STATUS_BOOT_FAILED\n");
      break;

    case MCUBOOT_STATUS_USB_DFU_WAITING:
      LOG_INF("MCUBOOT_STATUS_USB_DFU_WAITING\n");
      break;

    case MCUBOOT_STATUS_USB_DFU_ENTERED:
      LOG_INF("MCUBOOT_STATUS_USB_DFU_ENTERED\n");
      break;

    case MCUBOOT_STATUS_USB_DFU_TIMED_OUT:
      LOG_INF("MCUBOOT_STATUS_USB_DFU_TIMED_OUT\n");
      break;

    case MCUBOOT_STATUS_SERIAL_DFU_ENTERED:
      LOG_INF("MCUBOOT_STATUS_SERIAL_DFU_ENTERED\n");
      break;
    default:
      LOG_WRN("Unexpected state\n");
  }
}
```
