## prj.conf
```kconfig
# #
# # Copyright (c) 2021 Nordic Semiconductor ASA
# #
# # SPDX-License-Identifier: LicenseRef-Nordic-5-Clause
# #
#
#
# # Enable Bluetooth Low Energy
# CONFIG_BT=y
#
# # Add support for LEDs and buttons on Nordic development kits
CONFIG_DK_LIBRARY=y
#
# # Other settings
# CONFIG_LOG=y
# CONFIG_LOG_MODE_MINIMAL=y
#
# # Enable bootloader and DFU related configs
# CONFIG_BOOTLOADER_MCUBOOT=y
# CONFIG_UPDATEABLE_IMAGE_NUMBER=2
#
# QSPI configuration
CONFIG_NORDIC_QSPI_NOR=y
CONFIG_NORDIC_QSPI_NOR_FLASH_LAYOUT_PAGE_SIZE=4096
CONFIG_NORDIC_QSPI_NOR_STACK_WRITE_BUFFER_SIZE=16
#
# # MCU Manager and SMP configuration
# CONFIG_MCUMGR=y
# CONFIG_MCUMGR_CMD_IMG_MGMT=y
# CONFIG_MCUMGR_CMD_OS_MGMT=y
# CONFIG_MCUMGR_SMP_BT=y
# CONFIG_MCUMGR_SMP_BT_AUTHEN=n
# CONFIG_MCUMGR_BUF_COUNT=6
#
# # Increase BT MTU and RX buffer for big size DFU messages
# # CONFIG_BT_L2CAP_TX_MTU=498
# # CONFIG_BT_BUF_ACL_TX_SIZE=251
# # CONFIG_BT_BUF_ACL_RX_SIZE=502
#
#
# # Increase system workqueue size, as SMP is processed within it
# CONFIG_SYSTEM_WORKQUEUE_STACK_SIZE=2800
#
# # FLASH nop device is enabled to prevent bus faults when mcumgr tries to access
# # simulated partition with network core image data.
# CONFIG_FLASH_NOP_DEVICE=y
#
# # Enable custom SMP request to erase settings partition.
# CONFIG_MCUMGR_GRP_ZEPHYR_BASIC=y
# CONFIG_MCUMGR_GRP_BASIC_CMD_STORAGE_ERASE=y
#
```

## src/main.c
```c
/*
 * Copyright (c) 2012-2014 Wind River Systems, Inc.
 *
 * SPDX-License-Identifier: Apache-2.0
 */

#include <zephyr.h>
#include <sys/printk.h>
#include <dk_buttons_and_leds.h>

void main(void)
{
    printk("FFF\n");
    dk_leds_init();
    for(;;){
        k_sleep(K_SECONDS(1));
        dk_set_led_on(1);
        k_sleep(K_SECONDS(1));
        dk_set_led_off(1);

    }
}
```
