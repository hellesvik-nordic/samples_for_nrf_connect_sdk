## bootloader_samples/mcuboot_detached_signature/sample.yaml
```yaml
sample:
  description: MCUBoot sample using SMP server and manually signed images
    application
  name: MCUBoot with manual signed images
```

## bootloader_samples/mcuboot_serial_recovery_uart_53/mcuboot_smp_external_flash_53/sample.yaml
```yaml
sample:
  description: MCUBoot sample using SMP and external flash
    application
  name: MCUBoot SMP and external flash 
```

## bootloader_samples/mcuboot_simple/sample.yaml
```yaml
sample:
  description: Simple MCUBoot sample using nrfjprog to update
    application
  name: Simple MCUBoot sample
```

## bootloader_samples/mcuboot_smp/sample.yaml
```yaml
sample:
  description: Simple MCUBoot sample using SMP to update
    application
  name: Simple MCUBoot SMP sample
```

## lowlevel/eraseprotect/sample.yaml
```yaml
sample:
  description: Simple sample to show how to use the ERASEPROTECT feature for the nRF5340DK
  name: F5340 ERASEPROTECT sample
```
