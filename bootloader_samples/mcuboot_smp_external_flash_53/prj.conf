## prj.conf
```kconfig
CONFIG_BT=y

CONFIG_MCUMGR=y
CONFIG_MCUMGR_SMP_UART=y
CONFIG_MCUMGR_CMD_IMG_MGMT=y
CONFIG_MCUMGR_BUF_COUNT=6

CONFIG_SYSTEM_WORKQUEUE_STACK_SIZE=2800
CONFIG_FLASH=y

CONFIG_BOOTLOADER_MCUBOOT=y
CONFIG_UPDATEABLE_IMAGE_NUMBER=2
CONFIG_IMG_ERASE_PROGRESSIVELY=y

CONFIG_NORDIC_QSPI_NOR=y
CONFIG_NORDIC_QSPI_NOR_FLASH_LAYOUT_PAGE_SIZE=4096
CONFIG_NORDIC_QSPI_NOR_STACK_WRITE_BUFFER_SIZE=16

CONFIG_LOG=y

# FLASH nop device is enabled to prevent bus faults when mcumgr tries to access
# simulated partition with network core image data.
CONFIG_FLASH_NOP_DEVICE=y

CONFIG_MCUMGR_GRP_ZEPHYR_BASIC=y
CONFIG_MCUMGR_GRP_BASIC_CMD_STORAGE_ERASE=y
```

## src/main.c
```c
/*
 * Copyright (c) 2012-2014 Wind River Systems, Inc.
 *
 * SPDX-License-Identifier: Apache-2.0
 */

#include <zephyr.h>
#include <sys/printk.h>
#include "img_mgmt/img_mgmt.h"

void main(void)
{
    img_mgmt_register_group();
	printk("AAA  Hello World! %s\n", CONFIG_BOARD);
    while(1){
        k_sleep(K_SECONDS(1));
    }
}
```
