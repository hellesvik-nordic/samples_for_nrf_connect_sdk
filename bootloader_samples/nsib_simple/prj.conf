## sample.yaml
```
sample:
  description: Simple NSIB Sample
    application
  name: NSIB simple
```

## prj.conf
```kconfig
CONFIG_SECURE_BOOT=y
CONFIG_SB_SIGNING_KEY_FILE="priv.pem"
CONFIG_FW_INFO_FIRMWARE_VERSION=2
```

## src/main.c
```c
/*
 * Copyright (c) 2012-2014 Wind River Systems, Inc.
 *
 * SPDX-License-Identifier: Apache-2.0
 */

#include <zephyr.h>
#include <sys/printk.h>

void main(void)
{
	printk("Change this to see change.\n");
	printk("Firmware version %d\n", CONFIG_FW_INFO_FIRMWARE_VERSION);
}
```
