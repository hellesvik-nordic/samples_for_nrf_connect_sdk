## CMakeLists.txt
```
#
# Copyright (c) 2022 Nordic Semiconductor ASA
#
# SPDX-License-Identifier: LicenseRef-Nordic-5-Clause
#

cmake_minimum_required(VERSION 3.20.0)

set(ZEPHYR_EXTRA_MODULES ${CMAKE_CURRENT_LIST_DIR})

find_package(Zephyr REQUIRED HINTS $ENV{ZEPHYR_BASE})
project(app)

target_sources(app PRIVATE src/main.c)
```

## Kconfig
```
#
# Copyright (c) 2022 Nordic Semiconductor ASA
#
# SPDX-License-Identifier: LicenseRef-Nordic-5-Clause
#
source "Kconfig.zephyr"

config INCLUDE_CUSTOM_IMAGE
	bool "Include net image as sub image"
    default y
	select PARTITION_MANAGER_ENABLED

module=CUSTOM
source "${ZEPHYR_BASE}/../nrf/subsys/partition_manager/Kconfig.template.build_strategy"
```

## prj.conf
```kconfig
CONFIG_PRINTK=y
CONFIG_BOOTLOADER_MCUBOOT=n

CONFIG_CUSTOM_BUILD_STRATEGY_USE_HEX_FILE=y
CONFIG_CUSTOM_HEX_FILE="/home/bruk/git/samples_for_nrf_connect_sdk/build_system/custom_child_image/custom.hex"

CONFIG_LOG=y
CONFIG_RESET_ON_FATAL_ERROR=n
CONFIG_THREAD_NAME=y
```

## src/main.c
```c
/*
 * Copyright (c) 2022 Nordic Semiconductor ASA
 *
 * SPDX-License-Identifier: LicenseRef-Nordic-5-Clause
 */

#include <zephyr/kernel.h>
#include <zephyr/sys/printk.h>

#define RETURN68_ADDR   0xf83d4 // Found from searching build/zephyr/zephyr.map for "return68"

void main(void)
{
	printk("Hello world from app\n");

    void* function_ptr = (void*)(RETURN68_ADDR+1);

    uint8_t ret = ((uint8_t (*)(void*))function_ptr)(NULL);

    printk("Returned %d\n",ret);
}
```
